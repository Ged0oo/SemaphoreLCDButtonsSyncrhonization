# file: freeRTOS_temp.ioc
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FREERTOS.BinarySemaphores01=myBinarySem01,Dynamic,NULL
FREERTOS.Tasks01=task1,8,128,vTaskOne,Default,NULL,Dynamic,NULL,NULL;task2,8,128,vTaskTwo,Default,NULL,Dynamic,NULL,NULL
Mcu.Family=STM32F1
Mcu.Name=STM32F103C(8-B)Tx
Mcu.Package=LQFP48
NVIC.PriorityGroup=NVIC_PRIORITYGROUP_4
PD0-OSC_IN.Mode=HSE-External-Oscillator
PD0-OSC_IN.Signal=RCC_OSC_IN
PD1-OSC_OUT.Mode=HSE-External-Oscillator
PD1-OSC_OUT.Signal=RCC_OSC_OUT
ProjectManager.HeapSize=0x200
ProjectManager.StackSize=0x400
ProjectManager.TargetToolchain=STM32CubeIDE
RCC.AHBCLKDivider=RCC_SYSCLK_DIV2
RCC.AHBFreq_Value=8000000
RCC.APB1CLKDivider=RCC_HCLK_DIV4
RCC.APB1Freq_Value=2000000
RCC.APB1TimFreq_Value=4000000
RCC.APB2Freq_Value=8000000
RCC.APB2TimFreq_Value=8000000
RCC.HCLKFreq_Value=8000000
RCC.PLLSourceVirtual=RCC_PLLSOURCE_HSE
RCC.SYSCLKFreq_VALUE=16000000
RCC.SYSCLKSource=RCC_SYSCLKSOURCE_PLLCLK
RCC.USBFreq_Value=16000000
VP_FREERTOS_VS_CMSIS_V2.Mode=CMSIS_V2
board=custom

// file: Core/Src/main.c
/* USER CODE BEGIN Header */
/**
  ******************************************************************************
  * @file           : main.c
  * @brief          : Main program body
  ******************************************************************************
  * @attention
  *
  * Copyright (c) 2023 STMicroelectronics.
  * All rights reserved.
  *
  * This software is licensed under terms that can be found in the LICENSE file
  * in the root directory of this software component.
  * If no LICENSE file comes with this software, it is provided AS-IS.
  *
  ******************************************************************************
  */
/* USER CODE END Header */
#include "main.h"
#include "cmsis_os.h"
#include "gpio.h"

/* USER CODE BEGIN Includes */

#include "LED_interface.h"

/* USER CODE END Includes */

/* USER CODE BEGIN PV */

GPIO_ConfigType ButtonPin1 = {.GPIOx=GPIOA, .GPIO_PinNumber=GPIO_PIN_8  , .GPIO_PinMode=GPIO_IN};
GPIO_ConfigType ButtonPin2 = {.GPIOx=GPIOB, .GPIO_PinNumber=GPIO_PIN_3 , .GPIO_PinMode=GPIO_IN};

LED_ConfigType  LedPin1 =  {.GPIO_portX=GPIOB, .GPIO_pinX=GPIO_PIN_12 , .LED_state=LED_OFF};
LED_ConfigType  LedPin2 =  {.GPIO_portX=GPIOB, .GPIO_pinX=GPIO_PIN_9 , .LED_state=LED_OFF};

//GPIO_ConfigType ButtonPin2 = {.GPIOx=GPIOB, .GPIO_PinNumber=GPIO_PIN_7 , .GPIO_PinMode=GPIO_IN};

/* USER CODE END PV */

void SystemClock_Config(void);
void MX_FREERTOS_Init(void);

int main(void)
{

  /* MCU Configuration--------------------------------------------------------*/

  /* Reset of all peripherals, Initializes the Flash interface and the Systick. */
  HAL_Init();

  /* USER CODE BEGIN Init */

	MRCC_voidClockInit(&RCC_obj);
	MRCC_voidPeripheralClockEnable(RCC_APB2_BUS , RCC_GPIOA_CLOCK);
	MRCC_voidPeripheralClockEnable(RCC_APB2_BUS , RCC_GPIOB_CLOCK);

	lcd_4bit_intialize(&lcd_1);
	MGPIO_voidInitPortPin(&ButtonPin1);
	LED_vInit(&LedPin1);
	MGPIO_voidInitPortPin(&ButtonPin2);
	LED_vInit(&LedPin2);

  /* USER CODE END Init */

  /* Configure the system clock */
  SystemClock_Config();

  /* Initialize all configured peripherals */
  MX_GPIO_Init();

  /* Init scheduler */
  osKernelInitialize();  /* Call init function for freertos objects (in freertos.c) */
  MX_FREERTOS_Init();

  /* Start scheduler */
  osKernelStart();

  /* We should never get here as control is now taken by the scheduler */
  /* Infinite loop */
  while (1)
  {

  }
}

void SystemClock_Config(void)
{
  RCC_OscInitTypeDef RCC_OscInitStruct = {0};
  RCC_ClkInitTypeDef RCC_ClkInitStruct = {0};

  /** Initializes the RCC Oscillators according to the specified parameters
  * in the RCC_OscInitTypeDef structure.
  */
  RCC_OscInitStruct.OscillatorType = RCC_OSCILLATORTYPE_HSE;
  RCC_OscInitStruct.HSEState = RCC_HSE_ON;
  RCC_OscInitStruct.HSEPredivValue = RCC_HSE_PREDIV_DIV1;
  RCC_OscInitStruct.HSIState = RCC_HSI_ON;
  RCC_OscInitStruct.PLL.PLLState = RCC_PLL_ON;
  RCC_OscInitStruct.PLL.PLLSource = RCC_PLLSOURCE_HSE;
  RCC_OscInitStruct.PLL.PLLMUL = RCC_PLL_MUL2;
  if (HAL_RCC_OscConfig(&RCC_OscInitStruct) != HAL_OK)
  {
    Error_Handler();
  }

  /** Initializes the CPU, AHB and APB buses clocks
  */
  RCC_ClkInitStruct.ClockType = RCC_CLOCKTYPE_HCLK|RCC_CLOCKTYPE_SYSCLK
                              |RCC_CLOCKTYPE_PCLK1|RCC_CLOCKTYPE_PCLK2;
  RCC_ClkInitStruct.SYSCLKSource = RCC_SYSCLKSOURCE_PLLCLK;
  RCC_ClkInitStruct.AHBCLKDivider = RCC_SYSCLK_DIV2;
  RCC_ClkInitStruct.APB1CLKDivider = RCC_HCLK_DIV4;
  RCC_ClkInitStruct.APB2CLKDivider = RCC_HCLK_DIV1;

  if (HAL_RCC_ClockConfig(&RCC_ClkInitStruct, FLASH_LATENCY_0) != HAL_OK)
  {
    Error_Handler();
  }
}

void Error_Handler(void)
{
  __disable_irq();
  while (1)
  {
  }
}

// file: Core/Src/freertos.c
/* USER CODE BEGIN Header */
/**
  ******************************************************************************
  * File Name          : freertos.c
  * Description        : Code for freertos applications
  ******************************************************************************
  * @attention
  *
  * Copyright (c) 2023 STMicroelectronics.
  * All rights reserved.
  *
  * This software is licensed under terms that can be found in the LICENSE file
  * in the root directory of this software component.
  * If no LICENSE file comes with this software, it is provided AS-IS.
  *
  ******************************************************************************
  */
/* USER CODE END Header */

#include "FreeRTOS.h"
#include "task.h"
#include "main.h"
#include "cmsis_os.h"

/* USER CODE BEGIN Includes */
#include "stdio.h"
#include "LCD_interface.h"
#include "LED_interface.h"
#include "queue.h"

/* USER CODE END Includes */

/* USER CODE BEGIN Variables */

extern GPIO_ConfigType ButtonPin1;
extern LED_ConfigType  LedPin1;

extern GPIO_ConfigType ButtonPin2;
extern LED_ConfigType  LedPin2;

/* USER CODE END Variables */
/* Definitions for task1 */
osThreadId_t task1Handle;
const osThreadAttr_t task1_attributes = {
  .name = "task1",
  .stack_size = 128 * 4,
  .priority = (osPriority_t) osPriorityLow,
};
/* Definitions for task2 */
osThreadId_t task2Handle;
const osThreadAttr_t task2_attributes = {
  .name = "task2",
  .stack_size = 128 * 4,
  .priority = (osPriority_t) osPriorityNormal,
};
/* Definitions for myBinarySem01 */
osSemaphoreId_t myBinarySem01Handle;
const osSemaphoreAttr_t myBinarySem01_attributes = {
  .name = "myBinarySem01"
};

void vTaskOne(void *argument);
void vTaskTwo(void *argument);

void MX_FREERTOS_Init(void); /* (MISRA C 2004 rule 8.1) */

void MX_FREERTOS_Init(void) {

  /* Create the semaphores(s) */
  /* creation of myBinarySem01 */
  myBinarySem01Handle = osSemaphoreNew(1, 0, &myBinarySem01_attributes);

  /* Create the thread(s) */
  /* creation of task1 */
  task1Handle = osThreadNew(vTaskOne, NULL, &task1_attributes);

  /* creation of task2 */
  task2Handle = osThreadNew(vTaskTwo, NULL, &task2_attributes);

}

void vTaskOne(void *argument)
{
  /* USER CODE BEGIN vTaskOne */

	uint8_t bState;

  /* Infinite loop */
	for(;;)
	{
		bState = MGPIO_u8ReadPortPin(&ButtonPin1);
		if(GPIO_HIGH == bState)
		{
			lcd_4bit_send_string_pos(&lcd_1, 1, 1, "TaskOneRun");
			LED_vSetState(&LedPin1, LED_ON);
		}
		else if(GPIO_LOW == bState)
		{
			lcd_4bit_send_string_pos(&lcd_1, 1, 1, "NotTaskOne");
			LED_vSetState(&LedPin1, LED_OFF);
		}

		osSemaphoreRelease(myBinarySem01Handle);
	}
  /* USER CODE END vTaskOne */
}

void vTaskTwo(void *argument)
{
  /* USER CODE BEGIN vTaskTwo */

	uint8_t bState;

  /* Infinite loop */
	for(;;)
	{
		bState = MGPIO_u8ReadPortPin(&ButtonPin2);
		if(GPIO_HIGH == bState)
		{
			lcd_4bit_send_string_pos(&lcd_1, 2, 1, "TaskTwoRun");
			LED_vSetState(&LedPin2, LED_ON);
		}
		else if(GPIO_LOW == bState)
		{
			lcd_4bit_send_string_pos(&lcd_1, 2, 1, "NotTaskTwo");
			LED_vSetState(&LedPin2, LED_OFF);
		}

		osSemaphoreAcquire(myBinarySem01Handle, HAL_MAX_DELAY);
	}
  /* USER CODE END vTaskTwo */
}

/* USER CODE BEGIN Application */
/* Task to be created. */

/* USER CODE END Application */
